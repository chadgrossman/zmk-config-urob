#define CONFIG_WIRELESS
#define ZMK_BASE_LAYER(name, LT, RT, LM, RM, LB, RB, LH, RH)                \
    ZMK_LAYER(                                                              \
        name,                                                               \
            &kp TAB  LT RT &kp BSPC                                         \
            &kp ESC  LM RM &kp SEMICOLON                                    \
            &trans   LB RB &trans                                           \
            &kp LGUI LH RH &trans                                           \
    )

#include "zmk-helpers/key-labels/42.h"
#include "base.keymap"
